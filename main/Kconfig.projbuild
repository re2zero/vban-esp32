## main/Kconfig.projbuild
```kconfig
menu "Application Configuration"

config WIFI_SSID
    string "WiFi SSID"
	default "H3C"
	help
		SSID (network name) for the application to connect to.

config WIFI_PASSWORD
    string "WiFi Password"
	default "i12345678"
	help
		WiFi password (WPA or WPA2) for the application to use.
		Can be left blank if the network has no security set.

config SOCKET_PORT
    int "Socket port (send & receive)"
    range 0 65535
    default 6980
    help
        Socket port the vban will both send & receive UDP packets on.

config APP_STREAM_NAME
    string "vban deam stream name"
	default "esp32"
	help
		Set default stream name for vban UDP socket listen.

choice SOCKET_IP_VERSION
    prompt "IPV4 or IPV6 support"
    help
        Only support IPV4 or IPV6, don't set both.

config SOCKET_IPV4
    bool "IPV4 only support"

config SOCKET_IPV6
    bool "IPV6 only support"

endchoice

menu "Multicast configuration"

choice SOCKET_MULTICAST_IF
    prompt "Multicast Interface"
    help
        Multicast socket can bind to default interface, or all interfaces.

config SOCKET_MULTICAST_DEFAULT_IF
    bool "Default interface"
    help
        Multicast socket can bind to default interface, or all interfaces.

config SOCKET_MULTICAST_STA_IF
    bool "WiFi STA interface"

endchoice

    config SOCKET_MULTICAST_LOOPBACK
        int "Multicast loopback"
        range 0 1
        default 0
        help
            Enables IP_MULTICAST_LOOP/IPV6_MULTICAST_LOOP options, meaning
            that packets transmitted from the device are also received by the
            device itself.

    config SOCKET_MULTICAST_TTL
        int  "Multicast packet TTL"
        range 1 255
        help
            Sets TTL field of multicast packets. Separate from uni- & broadcast TTL.

    config SOCKET_MULTICAST_ADDR
        string "Multicast IPV4 or IPV6 Address (send & receive)"
        default "239.0.1.5"
        help
            IPV4 or IPV6 multicast address. IPV6 default address ff00::ef00:105 -> 239.0.1.5.
            Refer canvert https://www.subnetonline.com/pages/subnet-calculators/ipv4-to-ipv6-converter.php

endmenu

endmenu
```
